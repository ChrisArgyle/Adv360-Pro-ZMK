macro_app_windows: macro_app_windows{
compatible = "zmk,behavior-macro";
label = "macro_app_windows";
#binding-cells = <0>;
bindings = <&kt RCTRL>, <&kp DOWN>, <&kt RCTRL>;
};
macro_desktop_windows: macro_desktop_windows{
compatible = "zmk,behavior-macro";
label = "macro_desktop_windows";
#binding-cells = <0>;
bindings = <&kt LCTRL>, <&kp UP>, <&kt LCTRL>;
};
macro_prev_desktop: macro_prev_desktop{
compatible = "zmk,behavior-macro";
label = "macro_prev_desktop";
#binding-cells = <0>;
bindings = <&kt RIGHT_CONTROL>, <&kp LEFT>, <&kt RCTRL>;
};
macro_next_desktop: macro_next_desktop{
compatible = "zmk,behavior-macro";
label = "macro_next_desktop";
#binding-cells = <0>;
bindings = <&kt LEFT_CONTROL>, <&kp RIGHT>, <&kt LEFT_CONTROL>;
};